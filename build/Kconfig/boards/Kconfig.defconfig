## build/Kconfig/boards/Kconfig.defconfig
```kconfig
# Load Zephyr board defconfig descriptions.
osource "C:/ncs/v3.2.0/zephyr/boards/nordic/nrf52840dk/Kconfig.defconfig"
```

## build/UofT-Wearable-ECG-Monitor/Kconfig/boards/Kconfig
```kconfig
# Load Zephyr board Kconfig descriptions.
osource "C:/ncs/v3.2.0/zephyr/boards/nordic/nrf52840dk/Kconfig"
```

## build/UofT-Wearable-ECG-Monitor/Kconfig/boards/Kconfig.nrf52840dk
```kconfig
# Load board Kconfig descriptions.
osource "C:/ncs/v3.2.0/zephyr/boards/nordic/nrf52840dk/Kconfig.nrf52840dk"
```
